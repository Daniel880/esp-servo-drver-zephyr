## CMakeLists.txt
```
# SPDX-License-Identifier: Apache-2.0

cmake_minimum_required(VERSION 3.20.0)

find_package(Zephyr REQUIRED HINTS $ENV{ZEPHYR_BASE})
project(esp-servo-driver LANGUAGES CXX)

# Add source files
target_sources(app PRIVATE 
    src/main.cpp
    src/adapters/LedAdapter.cpp
    src/usecases/BlinkLedUseCase.cpp
)

# Include directories
target_include_directories(app PRIVATE src)
```

## west.yml
```
manifest:
  self:
    path: .

  remotes:
    - name: zephyrproject-rtos
      url-base: https://github.com/zephyrproject-rtos

  projects:
    - name: zephyr
      remote: zephyrproject-rtos
      revision: v4.2.0
      import:
        name-allowlist:
          - cmsis
          - hal_espressif
          - mbedtls
          - picolibc
```

## prj.conf
```kconfig
# ESP32 Servo Driver Configuration
CONFIG_GPIO=y

# ESP32 Servo Driver Configuration
CONFIG_GPIO=y

# C++ Support
CONFIG_CPP=y
CONFIG_STD_CPP17=y

# Shell Support
CONFIG_SHELL=y
CONFIG_SHELL_BACKEND_SERIAL=y
```

## boards/esp32_devkitc_procpu.overlay
```dts
/*
 * SPDX-License-Identifier: Apache-2.0
 */

/ {
	aliases {
		led0 = &myled0;
	};

	leds {
		compatible = "gpio-leds";
		myled0: led_0 {
			gpios = <&gpio0 2 GPIO_ACTIVE_HIGH>;
			label = "LED 0";
		};
	};
};
```

## src/main.c
```c
#include <zephyr/kernel.h>
#include <zephyr/drivers/gpio.h>

#define LED0_NODE DT_ALIAS(led0)

static const struct gpio_dt_spec led = GPIO_DT_SPEC_GET(LED0_NODE, gpios);

int main(void)
{
    int ret;
    bool led_state = true;

    if (!gpio_is_ready_dt(&led))
    {
        return 0;
    }

    ret = gpio_pin_configure_dt(&led, GPIO_OUTPUT_ACTIVE);
    if (ret < 0)
    {
        return 0;
    }

    while (1)
    {
        ret = gpio_pin_toggle_dt(&led);
        if (ret < 0)
        {
            return 0;
        }

        led_state = !led_state;
        printk("LED state: %s\n", led_state ? "ON" : "OFF");
        k_sleep(K_MSEC(1000));
    }
    return 0;
}
```

## src/main.cpp
```c
#include <zephyr/kernel.h>
#include <zephyr/logging/log.h>

#include "adapters/LedAdapter.h"
#include "usecases/BlinkLedUseCase.h"

LOG_MODULE_REGISTER(main, LOG_LEVEL_DBG);

int main(void)
{
    adapters::LedAdapter gpioAdapter;

    usecases::BlinkLedUseCase blinkUseCase(gpioAdapter);

    blinkUseCase.initialize();
    blinkUseCase.startThread();

    while (true)
    {
        k_sleep(K_MSEC(1000));
    }

    return 0;
}
```
